#include "dactyl_manuform_4x5.dtsi"

&default_transform { // The matrix transform for this board is 6 columns over because the left half is 6 columns wide according to the matrix.
    col-offset = <5>;
};

&kscan0 {
    col-gpios
        = <&pro_micro_d 9 GPIO_ACTIVE_HIGH>
        , <&pro_micro_d 8 GPIO_ACTIVE_HIGH>
        , <&pro_micro_d 7 GPIO_ACTIVE_HIGH>
        , <&pro_micro_d 6 GPIO_ACTIVE_HIGH>
        , <&pro_micro_d 5 GPIO_ACTIVE_HIGH>
        ;
};
