## config/boards/shields/dactyl_4x5/Kconfig.shield
```kconfig
config SHIELD_DACTYL_4X5_LEFT
    def_bool $(shields_list_contains,dactyl_4x5_left)

config SHIELD_DACTYL_4X5_RIGHT
    def_bool $(shields_list_contains,dactyl_4x5_right)
```
